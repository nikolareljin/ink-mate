## firmware/Kconfig.projbuild
```kconfig
menu "InkMate"

choice INKMATE_BOARD
    prompt "Board revision"
    default INKMATE_BOARD_V2
    help
        Select the revision printed on the PCB. Do not infer this from the product listing.
    config INKMATE_BOARD_V1
        bool "ESP32-S3 ePaper 1.54 V1 (non-touch)"
    config INKMATE_BOARD_V2
        bool "ESP32-S3 ePaper 1.54 V2 (non-touch)"
endchoice

config INKMATE_ENABLE_DEEP_SLEEP
    bool "Allow automatic deep sleep"
    default n
    help
        Keep disabled until cold boot and wake have passed on battery for this unit.

config INKMATE_ENABLE_OTA_REBOOT
    bool "Allow OTA-triggered reboot"
    default n
    help
        OTA download may be implemented, but reboot is blocked until battery reset testing passes.

config INKMATE_GATEWAY_URI
    string "Default gateway URI"
    default "http://inkmate.local:8080"

config INKMATE_PROVISIONING_POP
    string "BLE provisioning proof of possession"
    default ""
    help
        A per-device, randomly generated secret used by ESP-IDF provisioning
        security 1. Keep this empty in public builds: provisioning then fails
        closed. Supply it through a private sdkconfig overlay for bench use.
        Use at least 16 characters and never commit that overlay.

endmenu
```

## firmware/main/Kconfig.projbuild
```kconfig
menu "InkMate"

choice INKMATE_BOARD
    prompt "Board revision"
    default INKMATE_BOARD_V2
    help
        Select the revision printed on the PCB. Do not infer this from the product listing.
    config INKMATE_BOARD_V1
        bool "ESP32-S3 ePaper 1.54 V1 (non-touch)"
    config INKMATE_BOARD_V2
        bool "ESP32-S3 ePaper 1.54 V2 (non-touch)"
endchoice

config INKMATE_ENABLE_DEEP_SLEEP
    bool "Allow automatic deep sleep"
    default n
    help
        Keep disabled until cold boot and wake have passed on battery for this unit.

config INKMATE_ENABLE_OTA_REBOOT
    bool "Allow OTA-triggered reboot"
    default n
    help
        OTA download may be implemented, but reboot is blocked until battery reset testing passes.

config INKMATE_GATEWAY_URI
    string "Default gateway URI"
    default "http://inkmate.local:8080"

config INKMATE_GATEWAY_DEVICE_ID
    string "Gateway device identity"
    default ""
    help
        Private, enrolled device ID used for gateway discovery and request authentication.
        Keep empty in public builds. Supply it through an ignored private SDK config overlay.

config INKMATE_GATEWAY_DEVICE_SECRET
    string "Gateway device secret"
    default ""
    help
        Private per-device HMAC secret. Keep empty in public builds. Supply it through
        an ignored private SDK config overlay. The firmware never logs this value.

config INKMATE_PROVISIONING_POP
    string "BLE provisioning proof of possession"
    default ""
    help
        A per-device, randomly generated secret used by ESP-IDF provisioning
        security 1. Keep this empty in public builds: provisioning then fails
        closed. Supply it through a private sdkconfig overlay for bench use.
        Use at least 16 characters and never commit that overlay.

config INKMATE_WIFI_SSID
    string "Private Wi-Fi SSID"
    default ""

config INKMATE_WIFI_PASSWORD
    string "Private Wi-Fi password"
    default ""

endmenu
```

## firmware/sdkconfig.defaults
```kconfig
CONFIG_IDF_TARGET="esp32s3"
CONFIG_COMPILER_CXX_EXCEPTIONS=n
CONFIG_COMPILER_CXX_RTTI=n
CONFIG_ESPTOOLPY_FLASHSIZE_4MB=y
CONFIG_PARTITION_TABLE_CUSTOM=y
CONFIG_PARTITION_TABLE_CUSTOM_FILENAME="partitions.csv"
CONFIG_BOOTLOADER_APP_ROLLBACK_ENABLE=y
CONFIG_BOOTLOADER_WDT_ENABLE=y
CONFIG_ESP_TASK_WDT_EN=y
CONFIG_ESP_TASK_WDT_PANIC=y
CONFIG_NVS_ENCRYPTION=y
CONFIG_MBEDTLS_CERTIFICATE_BUNDLE=y
CONFIG_ESP_WIFI_NVS_ENABLED=y
CONFIG_LOG_DEFAULT_LEVEL_INFO=y
CONFIG_INKMATE_BOARD_V2=y
CONFIG_INKMATE_ENABLE_DEEP_SLEEP=n
CONFIG_INKMATE_ENABLE_OTA_REBOOT=n
```
